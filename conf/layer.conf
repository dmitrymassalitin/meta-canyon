## conf/layer.conf
```bitbake
# We have a conf and classes directory, add to BBPATH
BBPATH .= ":${LAYERDIR}"

# We have recipes-* directories, add to BBFILES
BBFILES += "${LAYERDIR}/recipes-*/*/*.bb \
            ${LAYERDIR}/recipes-*/*/*.bbappend"

BBFILE_COLLECTIONS += "meta-canyon"
BBFILE_PATTERN_meta-canyon = "^${LAYERDIR}/"
BBFILE_PRIORITY_meta-canyon = "6"

LAYERDEPENDS_meta-canyon = "core"
LAYERSERIES_COMPAT_meta-canyon = "scarthgap"
```
